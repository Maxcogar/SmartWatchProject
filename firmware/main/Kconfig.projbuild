## firmware/main/Kconfig.projbuild
```kconfig
# Project-specific configuration options for ESP32-S3 ADHD SmartWatch
# These options appear in menuconfig under "ADHD SmartWatch Configuration"

menu "ADHD SmartWatch Configuration"
    
    menu "Build Configuration"
        config ADHD_WATCH_DEBUG
            bool "Enable Debug Mode"
            default y
            help
                Enable debug mode with verbose logging and development features.
                Disable for production builds to reduce binary size and improve performance.
        
        config ADHD_WATCH_PRODUCTION
            bool "Production Build"
            default n
            depends on !ADHD_WATCH_DEBUG
            help
                Enable production-specific optimizations and security features.
                This should only be enabled for production releases.
    endmenu
    
    menu "Hardware Configuration"
        config ADHD_WATCH_DISPLAY_WIDTH
            int "Display Width"
            default 240
            range 240 240
            help
                Display width in pixels for ESP32-S3-Touch-LCD-2.
        
        config ADHD_WATCH_DISPLAY_HEIGHT
            int "Display Height" 
            default 320
            range 320 320
            help
                Display height in pixels for ESP32-S3-Touch-LCD-2.
        
        config ADHD_WATCH_TOUCH_I2C_SDA
            int "Touch I2C SDA GPIO"
            default 48
            range 0 48
            help
                GPIO number for touch controller I2C SDA line (confirmed from hardware example).
        
        config ADHD_WATCH_TOUCH_I2C_SCL
            int "Touch I2C SCL GPIO"
            default 47
            range 0 48
            help
                GPIO number for touch controller I2C SCL line (confirmed from hardware example).
        
        config ADHD_WATCH_TOUCH_INT
            int "Touch Interrupt GPIO"
            default -1
            range -1 48
            help
                GPIO number for touch controller interrupt line (not used in basic implementation).
        
        config ADHD_WATCH_TOUCH_RST
            int "Touch Reset GPIO"
            default -1
            range -1 48
            help
                GPIO number for touch controller reset line (not used in basic implementation).
        
        config ADHD_WATCH_BACKLIGHT_GPIO
            int "Display Backlight GPIO"
            default 1
            range 0 48
            help
                GPIO number controlling display backlight (confirmed from hardware example).
        
        config ADHD_WATCH_BATTERY_ADC_CHANNEL
            int "Battery ADC Channel"
            default 3
            range 0 9
            help
                ADC channel for battery voltage monitoring.
    endmenu
    
    menu "BLE Configuration"
        config ADHD_WATCH_BLE_DEVICE_NAME
            string "BLE Device Name"
            default "ADHD SmartWatch"
            help
                Bluetooth device name advertised to other devices.
        
        config ADHD_WATCH_BLE_SECURITY_LEVEL
            int "BLE Security Level"
            default 2
            range 0 3
            help
                BLE security level:
                0 - No security
                1 - Unauthenticated pairing
                2 - Authenticated pairing (recommended)
                3 - Authenticated pairing with MITM protection
    endmenu
    
    menu "Power Management"
        config ADHD_WATCH_BATTERY_LOW_THRESHOLD
            int "Battery Low Threshold (%)"
            default 20
            range 5 50
            help
                Battery percentage threshold for low battery warning.
        
        config ADHD_WATCH_BATTERY_CRITICAL_THRESHOLD
            int "Battery Critical Threshold (%)"
            default 5
            range 1 20
            help
                Battery percentage threshold for critical battery shutdown.
        
        config ADHD_WATCH_SLEEP_TIMEOUT_SECONDS
            int "Display Sleep Timeout (seconds)"
            default 30
            range 10 300
            help
                Number of seconds of inactivity before display turns off.
        
        config ADHD_WATCH_DEEP_SLEEP_TIMEOUT_MINUTES
            int "Deep Sleep Timeout (minutes)"
            default 5
            range 1 60
            help
                Number of minutes of inactivity before entering deep sleep.
    endmenu
    
    menu "Focus Session Configuration"
        config ADHD_WATCH_DEFAULT_FOCUS_DURATION
            int "Default Focus Duration (minutes)"
            default 25
            range 5 120
            help
                Default duration for focus sessions in minutes.
        
        config ADHD_WATCH_SHORT_BREAK_DURATION
            int "Short Break Duration (minutes)"
            default 5
            range 1 15
            help
                Duration for short breaks between focus sessions.
        
        config ADHD_WATCH_LONG_BREAK_DURATION
            int "Long Break Duration (minutes)"
            default 15
            range 10 60
            help
                Duration for long breaks after multiple focus sessions.
    endmenu
    
    menu "Notification Configuration"
        config ADHD_WATCH_MAX_NOTIFICATIONS
            int "Maximum Queued Notifications"
            default 10
            range 5 50
            help
                Maximum number of notifications that can be queued.
        
        config ADHD_WATCH_NOTIFICATION_TIMEOUT_SECONDS
            int "Notification Display Timeout (seconds)"
            default 10
            range 3 60
            help
                How long notifications are displayed before auto-dismissing.
    endmenu
    
    menu "Development & Testing"
        config ADHD_WATCH_ENABLE_TEST_MODE
            bool "Enable Test Mode"
            default n
            depends on ADHD_WATCH_DEBUG
            help
                Enable test mode with mock data and extended debugging.
        
        config ADHD_WATCH_ENABLE_OTA_UPDATE
            bool "Enable OTA Updates"
            default y
            help
                Enable Over-The-Air firmware update functionality.
        
        config ADHD_WATCH_LOG_LEVEL
            int "Log Level"
            default 3
            range 0 5
            depends on ADHD_WATCH_DEBUG
            help
                Logging level:
                0 - None
                1 - Error
                2 - Warning  
                3 - Info
                4 - Debug
                5 - Verbose
    endmenu

endmenu
```

## firmware/sdkconfig.defaults
```kconfig
# ESP32-S3 ADHD SmartWatch Default Configuration
# This file contains the default SDK configuration for the project
# Settings can be overridden using 'idf.py menuconfig'

# Target Configuration
CONFIG_IDF_TARGET="esp32s3"
CONFIG_IDF_TARGET_ESP32S3=y

# Compiler Options
CONFIG_COMPILER_OPTIMIZATION_SIZE=y
CONFIG_COMPILER_CXX_EXCEPTIONS=y
CONFIG_COMPILER_CXX_RTTI=y

# ESP32S3-Specific Configuration
CONFIG_ESP32S3_DEFAULT_CPU_FREQ_240=y
CONFIG_ESP32S3_DATA_CACHE_64KB=y
CONFIG_ESP32S3_DATA_CACHE_LINE_64B=y
CONFIG_ESP32S3_INSTRUCTION_CACHE_32KB=y

# Memory Configuration
CONFIG_ESP_MAIN_TASK_STACK_SIZE=8192
CONFIG_ESP_TIMER_TASK_STACK_SIZE=4096
CONFIG_ESP_SYSTEM_EVENT_TASK_STACK_SIZE=4096

# FreeRTOS Configuration
CONFIG_FREERTOS_HZ=1000
CONFIG_FREERTOS_USE_TRACE_FACILITY=y
CONFIG_FREERTOS_GENERATE_RUN_TIME_STATS=y

# Bluetooth Configuration
CONFIG_BT_ENABLED=y
CONFIG_BT_NIMBLE_ENABLED=y
CONFIG_BT_NIMBLE_MAX_CONNECTIONS=1
CONFIG_BT_NIMBLE_ROLE_PERIPHERAL=y
CONFIG_BT_NIMBLE_ROLE_BROADCASTER=y
CONFIG_BT_NIMBLE_SECURITY_ENABLE=y
CONFIG_BT_NIMBLE_SM_LEGACY=y
CONFIG_BT_NIMBLE_SM_SC=y

# WiFi Configuration
CONFIG_ESP_WIFI_ENABLED=y
CONFIG_ESP_WIFI_STATIC_RX_BUFFER_NUM=4
CONFIG_ESP_WIFI_DYNAMIC_RX_BUFFER_NUM=8
CONFIG_ESP_WIFI_STATIC_TX_BUFFER=y
CONFIG_ESP_WIFI_TX_BUFFER_TYPE=1
CONFIG_ESP_WIFI_STATIC_TX_BUFFER_NUM=4
CONFIG_ESP_WIFI_AMPDU_TX_ENABLED=y
CONFIG_ESP_WIFI_AMPDU_RX_ENABLED=y

# PSRAM Configuration
CONFIG_SPIRAM=y
CONFIG_SPIRAM_MODE_OCT=y
CONFIG_SPIRAM_SPEED_80M=y
CONFIG_SPIRAM_USE_MALLOC=y
CONFIG_SPIRAM_IGNORE_NOTFOUND=y

# LCD Configuration
CONFIG_LCD_ENABLE_DEBUG_LOG=n
CONFIG_LCD_PANEL_IO_ADDITIONS=y

# SPI Configuration
CONFIG_SPI_FLASH_ROM_DRIVER_PATCH=y
CONFIG_SPI_FLASH_DANGEROUS_WRITE_ABORTS=y

# ADC Configuration
CONFIG_ADC_ONESHOT_CTRL_FUNC_IN_IRAM=y
CONFIG_ADC_DMA_CTRL_FUNC_IN_IRAM=y

# I2C Configuration
CONFIG_I2C_ENABLE_DEBUG_LOG=n

# Power Management
CONFIG_PM_ENABLE=y
CONFIG_PM_DFS_INIT_AUTO=y
CONFIG_PM_USE_RTC_TIMER_REF=y
CONFIG_PM_PROFILING=y

# NVS Configuration
CONFIG_NVS_ENCRYPTION=y
CONFIG_NVS_SEC_KEY_PROTECT_USING_FLASH_ENC=y

# Flash Encryption & Secure Boot
CONFIG_SECURE_FLASH_ENC_ENABLED=n
CONFIG_SECURE_BOOT=n
# Note: Enable these for production builds

# Logging Configuration
CONFIG_LOG_DEFAULT_LEVEL_INFO=y
CONFIG_LOG_DEFAULT_LEVEL=3
CONFIG_LOG_MAXIMUM_EQUALS_DEFAULT=y
CONFIG_LOG_COLORS=y
CONFIG_LOG_TIMESTAMP_SOURCE_RTOS=y

# LVGL Configuration
CONFIG_LV_USE_DEMO_WIDGETS=n
CONFIG_LV_USE_DEMO_KEYPAD_AND_ENCODER=n
CONFIG_LV_USE_DEMO_BENCHMARK=n
CONFIG_LV_USE_DEMO_STRESS=n
CONFIG_LV_USE_DEMO_MUSIC=n
CONFIG_LV_MEM_CUSTOM=y
CONFIG_LV_MEMCPY_MEMSET_STD=y
CONFIG_LV_SPRINTF_CUSTOM=n
CONFIG_LV_USE_LOG=y
CONFIG_LV_LOG_LEVEL_WARN=y
CONFIG_LV_LOG_PRINTF=y
CONFIG_LV_FONT_DEFAULT_MONTSERRAT_14=y
CONFIG_LV_USE_FONT_COMPRESSED=y
CONFIG_LV_USE_FONT_SUBPX=y
CONFIG_LV_FONT_MONTSERRAT_8=y
CONFIG_LV_FONT_MONTSERRAT_10=y
CONFIG_LV_FONT_MONTSERRAT_12=y
CONFIG_LV_FONT_MONTSERRAT_14=y
CONFIG_LV_FONT_MONTSERRAT_16=y
CONFIG_LV_FONT_MONTSERRAT_18=y
CONFIG_LV_USE_PERF_MONITOR=y
CONFIG_LV_USE_MEM_MONITOR=y
CONFIG_LV_USE_REFR_DEBUG=n
CONFIG_LV_DISP_DEF_REFR_PERIOD=33
CONFIG_LV_DPI_DEF=130

# Touch Configuration
CONFIG_ESP_LCD_TOUCH_MAX_BUTTONS=0

# HTTP Client Configuration
CONFIG_ESP_HTTP_CLIENT_ENABLE_HTTPS=y
CONFIG_ESP_HTTP_CLIENT_ENABLE_BASIC_AUTH=y

# JSON Configuration  
CONFIG_JSON_MAX_NEST_LEVEL=32

# FatFS Configuration (for potential SD card support)
CONFIG_FATFS_CODEPAGE_437=y
CONFIG_FATFS_LFN_STACK=y
CONFIG_FATFS_MAX_LFN=255

# ESP Timer Configuration
CONFIG_ESP_TIMER_PROFILING=y
CONFIG_ESP_TIMER_TASK_STACK_SIZE=4096

# Task Watchdog Configuration
CONFIG_ESP_TASK_WDT=y
CONFIG_ESP_TASK_WDT_TIMEOUT_S=10
CONFIG_ESP_TASK_WDT_CHECK_IDLE_TASK_CPU0=y
CONFIG_ESP_TASK_WDT_CHECK_IDLE_TASK_CPU1=y

# Interrupt Watchdog Configuration
CONFIG_ESP_INT_WDT=y
CONFIG_ESP_INT_WDT_TIMEOUT_MS=300
CONFIG_ESP_INT_WDT_CHECK_CPU1=y

# Memory Protection
CONFIG_ESP_SYSTEM_MEMPROT_FEATURE=y

# Boot Configuration
CONFIG_BOOTLOADER_LOG_LEVEL_WARN=y
CONFIG_BOOTLOADER_SKIP_VALIDATE_IN_DEEP_SLEEP=y

# Console Configuration
CONFIG_ESP_CONSOLE_UART_DEFAULT=y
CONFIG_ESP_CONSOLE_UART_NUM=0
CONFIG_ESP_CONSOLE_UART_BAUDRATE=115200

# Component Configuration - App Update
CONFIG_APP_ROLLBACK_ENABLE=y
CONFIG_APP_ANTI_ROLLBACK=n

# mbedTLS Configuration
CONFIG_MBEDTLS_INTERNAL_MEM_ALLOC=y
CONFIG_MBEDTLS_SSL_MAX_CONTENT_LEN=4096
CONFIG_MBEDTLS_ASYMMETRIC_CONTENT_LEN=y
```
